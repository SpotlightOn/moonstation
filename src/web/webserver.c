#include "webserver.h"

#include <stddef.h>
#include <stdint.h>
#include <stdio.h>
#include <stdlib.h>
#include <string.h>

#include "esp_log.h"
#include "esp_netif.h"
#include "esp_system.h"
#include "esp_timer.h"
#include "esp_https_server.h"
#include "freertos/FreeRTOS.h"
#include "freertos/task.h"

#include "clock.h"
#include "power.h"
#include "net.h"
#include "settings.h"
#include "slideshow.h"
#include "status.h"
#include "certs.h"  // generated by scripts/generate_cert.sh, git-ignored
#include "pages.h"  // generated by scripts/generate_web.py from the files here

static const char *TAG = "web";

// A TLS socket costs about 40 kB of RAM, so the pool stays tiny: two sockets
// let a browser fetch the page and post the form without opening a second
// connection in parallel. If the heap cannot take it, start() retries with
// one.
#define WEB_SOCKETS 2

static httpd_handle_t server = NULL;
static bool server_on_ap = false;   // page is served over the setup access point
static bool busy = false;           // a start/stop worker is running
static int64_t last_activity_us = 0;
static char expected_auth[160] = ""; // "Basic <base64>", empty means no login

static void spawn(bool start);

//
// The pages. They live as plain files next to this one, because a form, a
// stylesheet and a script are easier to read, diff and edit than C string
// literals with escaped quotes. scripts/generate_web.py expands their
// <!-- include: ... --> directives and turns the result into pages.h
// (generated, git-ignored), so the firmware carries one document per page in
// flash: serving it is a single httpd_resp_send() of a few kB - no filesystem,
// no partition, nothing to mount, and no heap for a copy.
//
// CSS and JavaScript are inlined into that document, so the browser needs one
// request per page instead of one per asset. With two TLS sockets that keeps
// both sockets free for other clients while a page is open.
//

static esp_err_t send_page(httpd_req_t *req, const char *data, size_t len,
                           const char *type)
{
    httpd_resp_set_type(req, type);
    // The page and the API it talks to change together, so a cached copy from
    // an older build must not survive. The files are a few kB in flash and the
    // browser is on the local network, so refetching them costs nothing.
    httpd_resp_set_hdr(req, "Cache-Control", "no-store");
    return httpd_resp_send(req, data, len);
}

//
// Basic auth.
//

static const char B64[] =
    "ABCDEFGHIJKLMNOPQRSTUVWXYZabcdefghijklmnopqrstuvwxyz0123456789+/";

// Base64 of "user:password", written by hand so the whole check stays one
// comparison against the client header.
static void base64_encode(const char *in, char *out, size_t cap)
{
    size_t o = 0;
    size_t len = strlen(in);
    for (size_t i = 0; i < len && o + 4 < cap; i += 3) {
        uint32_t v = (uint8_t)in[i] << 16;
        if (i + 1 < len) v |= (uint8_t)in[i + 1] << 8;
        if (i + 2 < len) v |= (uint8_t)in[i + 2];
        out[o++] = B64[(v >> 18) & 0x3F];
        out[o++] = B64[(v >> 12) & 0x3F];
        out[o++] = (i + 1 < len) ? B64[(v >> 6) & 0x3F] : '=';
        out[o++] = (i + 2 < len) ? B64[v & 0x3F] : '=';
    }
    out[o] = '\0';
}

static void build_expected_auth(void)
{
    expected_auth[0] = '\0';
    // sanitize() keeps the setup password non-empty, so this is only a guard
    // against a hand-edited value reaching the server.
    if (settings.web_password[0] == '\0') return;
    char raw[100];
    char encoded[140];
    snprintf(raw, sizeof(raw), "%s:%s", settings.web_user, settings.web_password);
    base64_encode(raw, encoded, sizeof(encoded));
    snprintf(expected_auth, sizeof(expected_auth), "Basic %s", encoded);
}

static bool auth_ok(httpd_req_t *req)
{
    if (expected_auth[0] == '\0') return true;
    char got[176];
    if (httpd_req_get_hdr_value_len(req, "Authorization") == 0) return false;
    if (httpd_req_get_hdr_value_str(req, "Authorization", got, sizeof(got)) != ESP_OK) {
        return false;
    }
    return strcmp(got, expected_auth) == 0;
}

static esp_err_t deny(httpd_req_t *req)
{
    httpd_resp_set_hdr(req, "WWW-Authenticate", "Basic realm=\"moonstation\"");
    return httpd_resp_send_err(req, HTTPD_401_UNAUTHORIZED, "login required");
}

//
// The settings table the page may read and write. Everything outside of it
// stays a compile time value, see the comment on settings_t.
//

typedef enum { F_STR, F_U8, F_U16, F_U32, F_I8, F_I16 } field_type_t;

typedef struct {
    const char *key;
    field_type_t type;
    size_t offset;
    size_t size; // string capacity, unused for numbers
    int32_t lo;  // clamp range for numbers
    int32_t hi;
    bool secret; // never sent back to the browser, see config_get()
} field_t;

#define FIELD(f, t, s, lo, hi) {#f, t, offsetof(settings_t, f), s, lo, hi, false}
// A secret can only be written. The page gets "stored" or "not set" instead
// of the value, an empty field on save keeps what is stored, and the extra
// "<key>.clear" flag erases it.
#define SECRET_FIELD(f, s) {#f, F_STR, offsetof(settings_t, f), s, 0, 0, true}

static const field_t FIELDS[] = {
    FIELD(wifi_ssid, F_STR, 33, 0, 0),
    SECRET_FIELD(wifi_password, 65),
    FIELD(slide_dir, F_STR, 32, 0, 0),
    FIELD(radio_dir, F_STR, 32, 0, 0),
    FIELD(slide_interval_ms, F_U32, 0, 1000, 3600000),
    FIELD(slide_fade_ms, F_U16, 0, 0, 2000),
    FIELD(backlight_full_pct, F_U8, 0, 10, 100),
    FIELD(backlight_dim_pct, F_U8, 0, 0, 100),
    FIELD(backlight_deep_pct, F_U8, 0, 0, 100),
    FIELD(backlight_dim_after_sec, F_U8, 0, 1, 255),
    FIELD(backlight_deep_after_sec, F_U8, 0, 1, 255),
    FIELD(clock_deep_sleep_from, F_U8, 0, 0, 23),
    FIELD(clock_deep_sleep_to, F_U8, 0, 0, 23),
    FIELD(clock_deep_sleep_enable, F_U8, 0, 0, 1),
    FIELD(ntp_daily_sync_hour, F_I8, 0, -1, 23),
    FIELD(ntp_server, F_STR, 64, 0, 0),
    FIELD(tz_std_offset_min, F_I16, 0, -720, 840),
    FIELD(tz_eu_dst, F_U8, 0, 0, 1),
    FIELD(audio_volume, F_U8, 0, 0, 100),
    FIELD(battery_warn_pct, F_U16, 0, 0, 100),
    FIELD(battery_beep_volume, F_U8, 0, 0, 100),
    FIELD(weather_lat, F_STR, 12, 0, 0),
    FIELD(weather_lon, F_STR, 12, 0, 0),
    FIELD(weather_refresh_min, F_U16, 0, 5, 1440),
    SECRET_FIELD(weather_api_key, 73),
    FIELD(alarm_enabled, F_U8, 0, 0, 1),
    FIELD(alarm_hour, F_U8, 0, 0, 23),
    FIELD(alarm_minute, F_U8, 0, 0, 59),
    FIELD(web_user, F_STR, 33, 0, 0),
    SECRET_FIELD(web_password, 65),
};

#define FIELD_COUNT (sizeof(FIELDS) / sizeof(FIELDS[0]))
// config_post() tracks values and clear flags as one bit per field.
_Static_assert(FIELD_COUNT <= 32, "too many fields for the clear mask");

static void *field_ptr_in(const settings_t *s, const field_t *f)
{
    return (uint8_t *)s + f->offset;
}

static void *field_ptr(const field_t *f)
{
    return field_ptr_in(&settings, f);
}

static int32_t field_read_in(const settings_t *s, const field_t *f)
{
    switch (f->type) {
    case F_U8: {
        uint8_t v;
        memcpy(&v, field_ptr_in(s, f), sizeof(v));
        return v;
    }
    case F_U16: {
        uint16_t v;
        memcpy(&v, field_ptr_in(s, f), sizeof(v));
        return v;
    }
    case F_U32: {
        uint32_t v;
        memcpy(&v, field_ptr_in(s, f), sizeof(v));
        return (int32_t)v;
    }
    case F_I8: {
        int8_t v;
        memcpy(&v, field_ptr_in(s, f), sizeof(v));
        return v;
    }
    case F_I16: {
        int16_t v;
        memcpy(&v, field_ptr_in(s, f), sizeof(v));
        return v;
    }
    default: return 0;
    }
}

static void field_write_num(const field_t *f, int32_t v)
{
    switch (f->type) {
    case F_U8: {
        uint8_t x = (uint8_t)v;
        memcpy(field_ptr(f), &x, sizeof(x));
        break;
    }
    case F_U16: {
        uint16_t x = (uint16_t)v;
        memcpy(field_ptr(f), &x, sizeof(x));
        break;
    }
    case F_U32: {
        uint32_t x = (uint32_t)v;
        memcpy(field_ptr(f), &x, sizeof(x));
        break;
    }
    case F_I8: {
        int8_t x = (int8_t)v;
        memcpy(field_ptr(f), &x, sizeof(x));
        break;
    }
    case F_I16: {
        int16_t x = (int16_t)v;
        memcpy(field_ptr(f), &x, sizeof(x));
        break;
    }
    default: break;
    }
}

static bool unreserved(char c)
{
    return (c >= 'a' && c <= 'z') || (c >= 'A' && c <= 'Z') ||
           (c >= '0' && c <= '9') || c == '-' || c == '_' || c == '.' || c == '~';
}

// Percent encoding of the values the page receives; the client decodes them
// with URLSearchParams.
static void url_encode(const char *in, char *out, size_t cap)
{
    static const char hex[] = "0123456789ABCDEF";
    size_t o = 0;
    for (const unsigned char *p = (const unsigned char *)in; *p && o + 4 < cap; p++) {
        if (unreserved((char)*p)) {
            out[o++] = (char)*p;
        } else {
            out[o++] = '%';
            out[o++] = hex[*p >> 4];
            out[o++] = hex[*p & 0x0F];
        }
    }
    out[o] = '\0';
}

// Inverse of url_encode for the values the page posts ("+" is a space).
static void url_decode(const char *in, char *out, size_t cap)
{
    size_t o = 0;
    for (size_t i = 0; in[i] && o + 1 < cap; i++) {
        if (in[i] == '+') {
            out[o++] = ' ';
        } else if (in[i] == '%' && in[i + 1] && in[i + 2]) {
            char hex[3] = {in[i + 1], in[i + 2], '\0'};
            out[o++] = (char)strtol(hex, NULL, 16);
            i += 2;
        } else {
            out[o++] = in[i];
        }
    }
    out[o] = '\0';
}

// Copy with an explicit truncation point, so the compiler can see that the
// destination is never overrun (snprintf from an unbounded string trips
// -Wformat-truncation).
static void copy_str(char *dst, size_t cap, const char *src)
{
    if (cap == 0) return;
    size_t n = strlen(src);
    if (n >= cap) n = cap - 1;
    memcpy(dst, src, n);
    dst[n] = '\0';
}

//
// Handlers. httpd runs them one at a time in its own task, so the response
// buffers below can be static and stay off the stack.
//

static char resp_buf[6144];

static void touch_activity(void)
{
    last_activity_us = esp_timer_get_time();
}

static esp_err_t index_get(httpd_req_t *req)
{
    if (!auth_ok(req)) return deny(req);
    touch_activity();
    // While the factory login is active the page is the login form only. A box
    // that a visitor picked up must not show its settings to whoever finds it.
    if (settings_web_login_is_default()) {
        return send_page(req, setup_html, setup_html_len, "text/html");
    }
    return send_page(req, page_html, page_html_len, "text/html");
}

static esp_err_t config_get(httpd_req_t *req)
{
    if (!auth_ok(req)) return deny(req);
    touch_activity();

    // The labels show what the firmware was built with: the defaults are
    // computed into their own struct, so the live settings stay untouched.
    static settings_t defs;
    settings_defaults_into(&defs);

    size_t pos = 0;
    resp_buf[0] = '\0';
    for (size_t i = 0; i < FIELD_COUNT; i++) {
        const field_t *f = &FIELDS[i];
        char val[192];
        char def[192] = "";
        if (f->secret) {
            // Secrets are write-only: report whether one is stored, never the
            // value itself, and no default hint either - that would be the
            // build-time key from config.h.
            int n = snprintf(resp_buf + pos, sizeof(resp_buf) - pos, "%s%s.set=%d",
                             i ? "&" : "", f->key,
                             ((const char *)field_ptr(f))[0] ? 1 : 0);
            if (n < 0 || (size_t)n >= sizeof(resp_buf) - pos) break;
            pos += (size_t)n;
            continue;
        }
        if (f->type == F_STR) {
            url_encode((const char *)field_ptr(f), val, sizeof(val));
            const char *dflt = (const char *)field_ptr_in(&defs, f);
            if (dflt[0]) url_encode(dflt, def, sizeof(def));
        } else {
            snprintf(val, sizeof(val), "%ld", (long)field_read_in(&settings, f));
            snprintf(def, sizeof(def), "%ld", (long)field_read_in(&defs, f));
        }

        int n = snprintf(resp_buf + pos, sizeof(resp_buf) - pos, "%s%s=%s",
                         i ? "&" : "", f->key, val);
        if (n < 0 || (size_t)n >= sizeof(resp_buf) - pos) break;
        pos += (size_t)n;

        if (def[0] != '\0') {
            n = snprintf(resp_buf + pos, sizeof(resp_buf) - pos, "&%s.def=%s",
                         f->key, def);
            if (n < 0 || (size_t)n >= sizeof(resp_buf) - pos) break;
            pos += (size_t)n;
        }
    }

    httpd_resp_set_type(req, "application/x-www-form-urlencoded");
    return httpd_resp_send(req, resp_buf, HTTPD_RESP_USE_STRLEN);
}

// A restart after a save in setup mode: the response has to reach the browser
// before the connection dies, so the reset follows a moment later.
static void reboot_task(void *arg)
{
    vTaskDelay(pdMS_TO_TICKS(2000));
    esp_restart();
}

static void reboot_soon(void)
{
    if (xTaskCreate(reboot_task, "web_reboot", 2048, NULL, 5, NULL) != pdPASS) {
        esp_restart();
    }
}

static esp_err_t config_post(httpd_req_t *req)
{
    if (!auth_ok(req)) return deny(req);
    touch_activity();

    static char body[1024];
    size_t total = 0;
    while (total < sizeof(body) - 1) {
        int n = httpd_req_recv(req, body + total, sizeof(body) - 1 - total);
        if (n <= 0) break;
        total += (size_t)n;
    }
    body[total] = '\0';

    // "<key>.clear" is the explicit way to erase a secret; an empty secret
    // field on its own means "keep what is stored". The flags are collected
    // first, because the browser sends the field and its clear box in page
    // order: applying them as they arrive would erase a value that was just
    // typed next to a box the owner forgot to untick. A typed value wins.
    //
    // While the factory login is active only that login is accepted, and it
    // has to be a different password: everything else is ignored, so a box
    // with the default password cannot be configured by whoever finds it.
    const bool login_pending = settings_web_login_is_default();
    char new_user[sizeof(settings.web_user)] = "";
    char new_password[sizeof(settings.web_password)] = "";
    bool login_changed = false;
    bool wifi_changed = false;

    uint32_t seen = 0;
    uint32_t erase = 0;
    int applied = 0;
    for (char *kv = strtok(body, "&"); kv != NULL; kv = strtok(NULL, "&")) {
        char *eq = strchr(kv, '=');
        if (eq == NULL) continue;
        *eq = '\0';

        char key[40];
        char val[160];
        url_decode(kv, key, sizeof(key));
        url_decode(eq + 1, val, sizeof(val));

        bool clear = false;
        size_t klen = strlen(key);
        if (klen > 6 && strcmp(key + klen - 6, ".clear") == 0) {
            key[klen - 6] = '\0';
            clear = true;
        }

        const field_t *f = NULL;
        for (size_t i = 0; i < FIELD_COUNT; i++) {
            if (strcmp(FIELDS[i].key, key) == 0) {
                f = &FIELDS[i];
                break;
            }
        }
        if (f == NULL) continue;
        size_t idx = (size_t)(f - FIELDS);

        if (login_pending) {
            if (clear || f->type != F_STR) continue;
            if (strcmp(f->key, "web_user") == 0) {
                copy_str(new_user, sizeof(new_user), val);
            } else if (strcmp(f->key, "web_password") == 0) {
                copy_str(new_password, sizeof(new_password), val);
            }
            continue;
        }

        if (clear) {
            // The setup login is never erased: a page open to the whole local
            // network is worse than a password the owner has to remember.
            if (f->secret && strcmp(f->key, "web_password") != 0) {
                erase |= 1u << idx;
            }
            continue;
        }

        if (f->type == F_STR) {
            if (f->secret && val[0] == '\0') continue;
            snprintf((char *)field_ptr(f), f->size, "%s", val);
            if (strcmp(f->key, "web_user") == 0 ||
                strcmp(f->key, "web_password") == 0) {
                login_changed = true;
            }
            if (strcmp(f->key, "wifi_ssid") == 0 ||
                strcmp(f->key, "wifi_password") == 0) {
                wifi_changed = true;
            }
        } else {
            int32_t v = (int32_t)strtol(val, NULL, 10);
            if (v < f->lo) v = f->lo;
            if (v > f->hi) v = f->hi;
            field_write_num(f, v);
        }
        seen |= 1u << idx;
        applied++;
    }

    if (login_pending) {
        if (new_password[0] == '\0' ||
            strcmp(new_password, settings.web_password) == 0) {
            return httpd_resp_send_err(req, HTTPD_400_BAD_REQUEST,
                                       "set a password other than the factory one");
        }
        if (new_user[0] == '\0') {
            snprintf(new_user, sizeof(new_user), "%s", settings.web_user);
        }
        snprintf(settings.web_user, sizeof(settings.web_user), "%s", new_user);
        snprintf(settings.web_password, sizeof(settings.web_password), "%s",
                 new_password);
        settings_save();
        build_expected_auth();
        ESP_LOGI(TAG, "first setup done, login: %s", settings.web_user);
        httpd_resp_set_type(req, "text/plain");
        return httpd_resp_send(req, "login stored, signing in again",
                               HTTPD_RESP_USE_STRLEN);
    }

    // Erasing wipes the whole field: leaving the tail of the old secret in
    // the struct only confuses the next dump of the settings blob.
    for (size_t i = 0; i < FIELD_COUNT; i++) {
        if (!(erase & (1u << i)) || (seen & (1u << i))) continue;
        memset(field_ptr(&FIELDS[i]), 0, FIELDS[i].size);
        applied++;
    }

    settings_save();
    if (login_changed) {
        // The browser still sends the old header. Rebuild the comparison now
        // and tell the page to reload, where the new login is asked for.
        build_expected_auth();
        ESP_LOGI(TAG, "setup login changed, the page asks for the new one");
    }
    ESP_LOGI(TAG, "config saved, %d values, weather key %s", applied,
             settings.weather_api_key[0] ? "set" : "empty");
    clock_apply_timezone(); // the zone is applied on every render
    // Wake the mode manager: a changed alarm time has to re-arm the loop's
    // wake-up, and the page may have changed what the current frame shows.
    ui_force_redraw();

    // In setup mode the page only exists over the box's own access point.
    // With WiFi credentials stored it has to restart to join that network.
    const bool reboot =
        server_on_ap && wifi_changed && settings.wifi_ssid[0] != '\0';
    if (reboot) {
        ESP_LOGI(TAG, "WiFi stored in setup mode, restarting into the network");
        reboot_soon();
    }

    char msg[64];
    snprintf(msg, sizeof(msg), "ok, %d values stored%s%s", applied,
             login_changed ? ", relogin" : "", reboot ? ", reboot" : "");
    httpd_resp_set_type(req, "text/plain");
    return httpd_resp_send(req, msg, HTTPD_RESP_USE_STRLEN);
}

static esp_err_t reset_post(httpd_req_t *req)
{
    if (!auth_ok(req)) return deny(req);
    touch_activity();
    if (settings_web_login_is_default()) {
        return httpd_resp_send_err(req, HTTPD_403_FORBIDDEN,
                                   "set up your login first");
    }
    if (settings_reset_defaults() != ESP_OK) {
        return httpd_resp_send_err(req, HTTPD_500_INTERNAL_SERVER_ERROR,
                                   "reset failed");
    }
    clock_apply_timezone(); // the zone is applied on every render
    ui_force_redraw();      // the reset may have changed the alarm time
    httpd_resp_set_type(req, "text/plain");
    return httpd_resp_send(req, "reset done", HTTPD_RESP_USE_STRLEN);
}

static esp_err_t shutdown_post(httpd_req_t *req)
{
    if (!auth_ok(req)) return deny(req);
    touch_activity();
    httpd_resp_send(req, "stopping", HTTPD_RESP_USE_STRLEN);
    spawn(false); // after the response has gone out
    return ESP_OK;
}

static const httpd_uri_t URI_INDEX = {
    .uri = "/", .method = HTTP_GET, .handler = index_get,
};
static const httpd_uri_t URI_CONFIG_GET = {
    .uri = "/api/config", .method = HTTP_GET, .handler = config_get,
};
static const httpd_uri_t URI_CONFIG_POST = {
    .uri = "/api/config", .method = HTTP_POST, .handler = config_post,
};
static const httpd_uri_t URI_SHUTDOWN = {
    .uri = "/api/shutdown", .method = HTTP_POST, .handler = shutdown_post,
};
static const httpd_uri_t URI_RESET = {
    .uri = "/api/reset", .method = HTTP_POST, .handler = reset_post,
};

//
// Start and stop. Both run in their own task: the connect and the TLS
// handshake block for seconds.
//

static esp_timer_handle_t idle_timer = NULL;

static void idle_timer_cb(void *arg);

static void start_idle_timer(void)
{
    if (idle_timer) return;
    const esp_timer_create_args_t args = {
        .callback = idle_timer_cb,
        .name = "web_idle",
    };
    if (esp_timer_create(&args, &idle_timer) != ESP_OK) {
        ESP_LOGW(TAG, "idle timer unavailable, the server stays up");
        return;
    }
    esp_timer_start_periodic(idle_timer, 30 * 1000000LL);
}

static void stop_idle_timer(void)
{
    if (!idle_timer) return;
    esp_timer_stop(idle_timer);
    esp_timer_delete(idle_timer);
    idle_timer = NULL;
}

// The page closes itself after the configured time without requests, so a
// forgotten session does not keep the radio up all night.
static void idle_timer_cb(void *arg)
{
    int64_t idle_s = (esp_timer_get_time() - last_activity_us) / 1000000LL;
    int64_t limit = (int64_t)settings.web_idle_timeout_min * 60;
    if (idle_s >= limit) {
        ESP_LOGI(TAG, "no request for %lld min, shutting down", (long long)limit / 60);
        spawn(false);
    }
}

static bool start_server(void)
{
    if (server) return true;

    // TLS is the only workload that gains from 240 MHz; the profile keeps
    // the clock there until the page closes.
    power_request(POWER_PROFILE_BOOST);

    // The page has to be reachable even when the box is not on a network yet:
    // a factory-fresh box serves it over its own access point. The same path
    // covers a box whose home network is gone (moved house, new router).
    bool on_ap = false;
    if (!net_wifi_up()) {
        if (!net_ap_start()) {
            ESP_LOGE(TAG, "neither WiFi nor the setup access point came up");
            power_release(POWER_PROFILE_BOOST);
            return false;
        }
        on_ap = true;
    }

    esp_netif_t *netif = esp_netif_get_handle_from_ifkey(
        on_ap ? "WIFI_AP_DEF" : "WIFI_STA_DEF");
    esp_netif_ip_info_t ip = {0};
    if (!netif || esp_netif_get_ip_info(netif, &ip) != ESP_OK || ip.ip.addr == 0) {
        ESP_LOGE(TAG, "no address for the setup page");
        if (on_ap) {
            net_ap_stop();
        } else {
            net_wifi_down();
        }
        power_release(POWER_PROFILE_BOOST);
        return false;
    }

    // Hold the link: the daily NTP sync may bring the radio down again, and
    // the page must survive that. The AP is not touched by the power save
    // code, so there is nothing to hold there.
    if (!on_ap) net_wifi_hold();
    build_expected_auth();

    httpd_ssl_config_t conf = HTTPD_SSL_CONFIG_DEFAULT();
    conf.httpd.max_open_sockets = WEB_SOCKETS;
    // A browser sends 700-900 bytes of request headers, the 512 byte default
    // of the httpd makes it answer "Header fields are too long".
    conf.httpd.max_req_hdr_len = 2048;
    // mbedtls wants PEM buffers with their terminating NUL counted in the
    // length; without it, the parse fails with a buffer error.
    conf.servercert = (const uint8_t *)server_cert_pem;
    conf.servercert_len = sizeof(server_cert_pem);
    conf.prvtkey_pem = (const uint8_t *)server_key_pem;
    conf.prvtkey_len = sizeof(server_key_pem);
    conf.transport_mode = HTTPD_SSL_TRANSPORT_SECURE;

    esp_err_t err = httpd_ssl_start(&server, &conf);
    if (err != ESP_OK) {
        // Most likely not enough heap left for a second TLS socket; one
        // connection still serves the page, the browser reuses it.
        ESP_LOGW(TAG, "https start failed (%s), retrying with one socket",
                 esp_err_to_name(err));
        conf.httpd.max_open_sockets = 1;
        err = httpd_ssl_start(&server, &conf);
    }
    if (err != ESP_OK) {
        ESP_LOGE(TAG, "https server not started: %s", esp_err_to_name(err));
        server = NULL;
        if (on_ap) {
            net_ap_stop();
        } else {
            net_wifi_release();
            net_wifi_down();
        }
        power_release(POWER_PROFILE_BOOST);
        return false;
    }

    httpd_register_uri_handler(server, &URI_INDEX);
    httpd_register_uri_handler(server, &URI_CONFIG_GET);
    httpd_register_uri_handler(server, &URI_CONFIG_POST);
    httpd_register_uri_handler(server, &URI_SHUTDOWN);
    httpd_register_uri_handler(server, &URI_RESET);

    server_on_ap = on_ap;
    snprintf(ui_status.ip, sizeof(ui_status.ip), IPSTR, IP2STR(&ip.ip));
    ui_status.web_server = true;
    last_activity_us = esp_timer_get_time();
    start_idle_timer();

    ESP_LOGI(TAG, "setup page: https://%s/", ui_status.ip);
    if (on_ap) {
        ESP_LOGI(TAG, "join the open access point \"%s\" to reach it",
                 net_ap_ssid());
    }
    ESP_LOGI(TAG, "login: %s", settings.web_user);
    if (settings_web_login_is_default()) {
        ESP_LOGW(TAG, "factory login active, the page asks for a new one");
    }
    ESP_LOGI(TAG, "free heap %u bytes", (unsigned)esp_get_free_heap_size());
    ui_force_redraw();
    return true;
}

static void stop_server(void)
{
    stop_idle_timer();

    if (server) {
        httpd_handle_t handle = server;
        server = NULL;
        httpd_ssl_stop(handle);
        ESP_LOGI(TAG, "setup page closed");
    }

    ui_status.web_server = false;
    ui_status.ip[0] = '\0';
    ui_force_redraw();

    if (server_on_ap) {
        server_on_ap = false;
        net_ap_stop();
    } else {
        net_wifi_release();
        net_wifi_down();
    }
    power_release(POWER_PROFILE_BOOST);
}

static void web_task(void *arg)
{
    bool start = (bool)(intptr_t)arg;
    if (start) {
        start_server();
    } else {
        stop_server();
    }
    busy = false;
    vTaskDelete(NULL);
}

static void spawn(bool start)
{
    if (busy) return; // a toggle while the server is still starting
    busy = true;
    if (xTaskCreate(web_task, "web_setup", 6144, (void *)(intptr_t)start, 5, NULL)
        != pdPASS) {
        busy = false;
        ESP_LOGE(TAG, "setup task not created");
    }
}

void web_start(void)
{
    if (!server) spawn(true);
}

void web_stop(void)
{
    if (server) spawn(false);
}

void web_toggle(void)
{
    spawn(!server);
}

bool web_is_running(void)
{
    return server != NULL;
}
